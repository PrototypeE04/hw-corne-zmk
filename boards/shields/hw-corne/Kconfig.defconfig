## boards/shields/hw-corne/Kconfig.defconfig
```kconfig
if SHIELD_HW-CORNE_LEFT

config ZMK_KEYBOARD_NAME
    default "HW-Corne"

config ZMK_SPLIT_ROLE_CENTRAL
    default y

endif

if SHIELD_HW-CORNE_LEFT || SHIELD_HW-CORNE_RIGHT

config ZMK_SPLIT
    default y

endif
```

## boards/shields/hw-corne/Kconfig.shield
```kconfig
config SHIELD_HW-CORNE_LEFT
    def_bool $(shields_list_contains,HW-Corne_left)

config SHIELD_HW-CORNE_RIGHT
    def_bool $(shields_list_contains,HW-Corne_right)
```
